## build/conf/bblayers.conf
```bitbake
# --- OLYMPUS: CAPAS DEL PROYECTO ---

POKY_BBLAYERS_CONF_VERSION = "2"

BBPATH = "\${TOPDIR}"
BBFILES ?= ""

BBLAYERS ?= " \\
  \${TOPDIR}/../layers/poky/meta \\
  \${TOPDIR}/../layers/poky/meta-poky \\
  \${TOPDIR}/../layers/poky/meta-yocto-bsp \\
  \${TOPDIR}/../layers/meta-openembedded/meta-oe \\
  \${TOPDIR}/../layers/meta-openembedded/meta-python \\
  \${TOPDIR}/../layers/meta-openembedded/meta-multimedia \\
  \${TOPDIR}/../layers/meta-openembedded/meta-networking \\
  \${TOPDIR}/../layers/meta-raspberrypi \\
  \${TOPDIR}/../layers/meta-olympus \\
  "
```

## conf/layer.conf
```bitbake
BBPATH .= ":${LAYERDIR}"
BBFILES += "${LAYERDIR}/recipes-*/*/*.bb             ${LAYERDIR}/recipes-*/*/*.bbappend"
BBFILE_COLLECTIONS += "meta-olympus"
BBFILE_PATTERN_meta-olympus = "^${LAYERDIR}/"
BBFILE_PRIORITY_meta-olympus = "10"
LAYERSERIES_COMPAT_meta-olympus = "scarthgap"
LAYERDEPENDS_meta-olympus = "core raspberrypi"
```

## layers/meta-olympus/conf/layer.conf
```bitbake
# Version: v1.2
BBPATH .= ":${LAYERDIR}"

# Use kernel 6.12 (instead of meta-raspberrypi default 6.6) to get the
# pisp-fe V4L2 sub-device registration fix required for RPi5 camera capture.
PREFERRED_VERSION_linux-raspberrypi = "6.12%"
BBFILES += "${LAYERDIR}/recipes-*/*/*.bb             ${LAYERDIR}/recipes-*/*/*.bbappend"
BBFILE_COLLECTIONS += "meta-olympus"
BBFILE_PATTERN_meta-olympus = "^${LAYERDIR}/"
BBFILE_PRIORITY_meta-olympus = "10"
LAYERSERIES_COMPAT_meta-olympus = "scarthgap"
LAYERDEPENDS_meta-olympus = "core raspberrypi openembedded-layer meta-python networking-layer"
```
